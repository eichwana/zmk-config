## config/west.yml
```yaml
manifest:
  remotes:
    - name: zmkfirmware
      url-base: https://github.com/zmkfirmware

  projects:
    - name: zmk
      remote: zmkfirmware
      revision: v0.3
      import: app/west.yml

      
  self:
    path: config

manifest:
  remotes:
    - name: kbrd-space
      url-base: https://github.com/kbrd-space
  projects:
    - name: zmk-anti-idle
      remote: kbrd-space
      revision: main
```
